## drivers/display/Kconfig
```kconfig
# SPDX-License-Identifier: Apache-2.0

config DISPLAY_WAVESHARE_ESP32S3_RGB
	bool "Waveshare ESP32-S3 LCD_CAM RGB/DPI display driver (experimental, out-of-tree)"
	default y
	depends on DT_HAS_WAVESHARE_ESP32S3_LCD_CAM_RGB_ENABLED
	select DISPLAY
	help
	  Experimental out-of-tree driver that programs the ESP32-S3 LCD_CAM
	  peripheral in parallel RGB/DPI timing-generator mode plus a
	  dedicated GDMA channel driven directly at the HAL level (bypassing
	  Zephyr's generic espressif,esp32-gdma driver, which does not support
	  cyclic/circular descriptor lists needed for continuous frame
	  streaming). Unblank resets the LCD and DMA and primes the FIFO
	  before starting pixel output. Applications can blank the display
	  while drawing their initial frame to avoid concurrent PSRAM
	  rendering and scanout during startup. Hardware validation is
	  still required. The pixel clock uses the Espressif HAL divider
	  calculation, including its prescaler workaround for LCD clock
	  instability when the pixel-clock prescaler is bypassed.
	  Two internal-SRAM bounce buffers isolate GDMA from PSRAM bus
	  contention. An IRAM-resident VSYNC handler recovers missed buffer
	  deadlines, compensating for the ESP32-S3 LCD FIFO's retained pixels.
	  PSRAM/cache must remain accessible while scanout is active; blank
	  the display before operations that disable external-memory access.
```

## dts/bindings/display/waveshare,esp32s3-lcd-cam-rgb copy.yaml
```yaml
description: |
  EXPERIMENTAL, out-of-tree binding for the ESP32-S3 LCD_CAM peripheral
  operated in parallel RGB/DPI timing-generator mode (hsync/vsync/de/pclk +
  N-bit parallel data bus), as used by panels such as the Waveshare
  ESP32-S3-Touch-LCD-7.

  This is NOT an upstream Zephyr binding. Zephyr mainline only supports
  LCD_CAM in I8080/DBI mode (espressif,esp32-lcd-cam-mipi-dbi) and, on
  ESP32-P4, MIPI-DSI. This binding models the RGB timing-generator submode
  that upstream does not yet cover, and is meant to be added as a child of
  the SoC-provided `espressif,esp32-lcd-cam` node (the same parent used by
  `espressif,esp32-lcd-cam-mipi-dbi` / `espressif,esp32-lcd-cam-dvp`), so it
  inherits that node's reg/interrupts/clocks/pinctrl properties.

  Example (board overlay):

    &lcd_cam {
        status = "okay";
        pinctrl-0 = <&lcd_cam_default>;
        pinctrl-names = "default";

        rgb_disp: rgb-display {
            compatible = "waveshare,esp32s3-lcd-cam-rgb";
            status = "okay";
            dmas = <&gdma0 0>;
            dma-names = "tx";
            width = <800>;
            height = <480>;
            pixel-clk-hz = <16000000>;
            hsync-len = <4>;
            hback-porch = <8>;
            hfront-porch = <8>;
            vsync-len = <4>;
            vback-porch = <8>;
            vfront-porch = <8>;
            data-width = <16>;
            pclk-active-neg;
        };
    };

compatible: "waveshare,esp32s3-lcd-cam-rgb_dummy"

include: [display-controller.yaml]

properties:
  dmas:
    required: true
    description: |
      Phandle to the GDMA controller. NOTE - this driver claims and drives
      the referenced channel directly at the gdma_hal_*() level (a circular,
      never-NULL-terminated descriptor list), it does NOT go through
      Zephyr's dma_start()/dma_config() API, because the generic
      espressif,esp32-gdma driver always NULL-terminates its descriptor
      chain and has no cyclic mode. The phandle is only used to identify
      which GDMA instance/channel number to claim exclusively.

  dma-names:
    required: true

  width:
    type: int
    required: true
    description: Panel horizontal resolution in pixels.

  height:
    type: int
    required: true
    description: Panel vertical resolution in pixels.

  pixel-clk-hz:
    type: int
    required: true
    description: LCD_CAM PCLK frequency in Hz.

  hsync-len:
    type: int
    required: true

  hback-porch:
    type: int
    required: true

  hfront-porch:
    type: int
    required: true

  vsync-len:
    type: int
    required: true

  vback-porch:
    type: int
    required: true

  vfront-porch:
    type: int
    required: true

  data-width:
    type: int
    default: 16
    description: Parallel RGB data bus width (8 or 16).

  hsync-idle-low:
    type: boolean
    description: HSYNC signal idles low (active high) if set.

  vsync-idle-low:
    type: boolean
    description: VSYNC signal idles low (active high) if set.

  de-idle-high:
    type: boolean
    description: DE (data enable) signal idles high if set.

  pclk-active-neg:
    type: boolean
    description: Sample/shift data on the falling edge of PCLK if set.

  # ESP32-S3 routes LCD_CAM RGB signals through the GPIO matrix rather than
  # static IOMUX pinctrl, so (unlike most Zephyr display drivers) the pin
  # assignment is expressed here as plain GPIO phandle-arrays instead of a
  # pinctrl-0 group, mirroring ESP-IDF's esp_lcd_rgb_panel_config_t.
  hsync-gpios:
    type: phandle-array
    required: true
  vsync-gpios:
    type: phandle-array
    required: true
  de-gpios:
    type: phandle-array
    required: true
  pclk-gpios:
    type: phandle-array
    required: true
  data-gpios:
    type: phandle-array
    required: true
    description: 8 or 16 entries (matches data-width), data0 first.
```

## dts/bindings/display/waveshare,esp32s3-lcd-cam-rgb.yaml
```yaml
# SPDX-License-Identifier: Apache-2.0

compatible: "waveshare,esp32s3-lcd-cam-rgb"

description: |
  Waveshare ESP32-S3 LCD_CAM RGB display.

include:
  - display-controller.yaml
  - pinctrl-device.yaml

properties:
  width:
    type: int
    required: true

  height:
    type: int
    required: true

  pixel-clk-hz:
    type: int
    required: true
    description: RGB panel pixel clock frequency, in Hz

  hsync-len:
    type: int
    required: true

  hback-porch:
    type: int
    required: true

  hfront-porch:
    type: int
    required: true

  vsync-len:
    type: int
    required: true

  vback-porch:
    type: int
    required: true

  vfront-porch:
    type: int
    required: true

  data-width:
    type: int
    default: 16
    description: Number of parallel RGB data lines (8 or 16)

  hsync-idle-low:
    type: boolean
    description: HSYNC signal is active-high when set (idle state is low)

  vsync-idle-low:
    type: boolean
    description: VSYNC signal is active-high when set (idle state is low)

  de-idle-high:
    type: boolean
    description: DE signal is active-low when set (idle state is high)

  pclk-active-neg:
    type: boolean
    description: Data is clocked out on the falling edge of PCLK when set

  dmas:
    required: true

  dma-names:
    required: true
```

## tests/zephyr/testcase.yaml
```yaml
tests:
  rgb_lcd_module.build:
    build_only: true
    platform_allow:
      - esp32s3_devkitc/esp32s3/procpu
    tags:
      - display
```
